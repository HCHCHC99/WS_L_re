#include "timer6_timebase.h"


/* Timer6 配置 */
#define TMR6_DIV_VAL         64u    /* 定时器分频值 */
#define TMR6_PERIOD_MAX      0xFFFFu /* 16位定时器最大值 */

/* 全局变量 */
static uint32_t m_u32TimerFreq = 0;     /* Timer6实际计数频率 */
static volatile uint32_t m_u32LastCounter = 0;
static volatile uint32_t m_u32DeltaCounter = 0;
static volatile uint64_t s_total_elapsed_us = 0;
static volatile uint32_t s_last_timer6_counter = 0;
static uint8_t s_timestamp_initialized = 0;

/**
 * @brief Timer6 初始化
 */
void Timer6_Timebase_Init(void) {
    stc_tmr6_init_t stcTmrInit;
    
    /* 获取PCLK0时钟频率（Timer6使用PCLK0） */
    uint32_t u32Pclk0Freq = CLK_GetBusClockFreq(CLK_BUS_PCLK0);
    
    /* 计算Timer6的实际计数频率 */
    m_u32TimerFreq = u32Pclk0Freq / TMR6_DIV_VAL;
    
    /* 使能Timer62时钟 */
    FCG_Fcg2PeriphClockCmd(FCG2_PERIPH_TMR6_2, ENABLE);
    
    /* 复位Timer62 */
    TMR6_DeInit(CM_TMR6_2);
    
    /* 初始化结构体为默认值 */
    TMR6_StructInit(&stcTmrInit);
    
    /* 配置为软件计数模式，向上计数，PCLK/64分频 */
    stcTmrInit.u8CountSrc = TMR6_CNT_SRC_SW;
    stcTmrInit.sw_count.u32CountDir = TMR6_CNT_UP;
    stcTmrInit.sw_count.u32ClockDiv = TMR6_CLK_DIV64;
    stcTmrInit.sw_count.u32CountMode = TMR6_MD_SAWTOOTH;
    stcTmrInit.u32PeriodValue = TMR6_PERIOD_MAX;
    
    TMR6_Init(CM_TMR6_2, &stcTmrInit);
    
    /* 清除中断标志 */
    TMR6_ClearStatus(CM_TMR6_2, TMR6_FLAG_CLR_ALL);
    
    /* 禁用所有中断 */
    TMR6_IntCmd(CM_TMR6_2, TMR6_INT_ALL, DISABLE);
    
    /* 初始化计数器值 */
    m_u32LastCounter = 0;
    m_u32DeltaCounter = 0;
    s_timestamp_initialized = 0;
}

/* 其余函数保持不变... */
void Timer6_Timebase_Start(void) { TMR6_Start(CM_TMR6_2); }
void Timer6_Timebase_Stop(void) { TMR6_Stop(CM_TMR6_2); }
uint32_t Timer6_Timebase_GetCounter(void) { return TMR6_GetCountValue(CM_TMR6_2); }
uint32_t Timer6_Timebase_GetFrequency(void) { return m_u32TimerFreq; }

uint32_t Timer6_Timebase_GetDelta(void) {
    uint32_t u32CurrentCounter = Timer6_Timebase_GetCounter();
    uint32_t u32Delta = 0;
    
    if (u32CurrentCounter >= m_u32LastCounter) {
        u32Delta = u32CurrentCounter - m_u32LastCounter;
    } else {
        u32Delta = (65536u - m_u32LastCounter) + u32CurrentCounter;
    }
    
    m_u32LastCounter = u32CurrentCounter;
    m_u32DeltaCounter = u32Delta;
    return u32Delta;
}

uint32_t Timer6_Timebase_DeltaToUs(uint32_t u32DeltaCounter) {
    if (m_u32TimerFreq == 0) return 0;
    return (u32DeltaCounter * 1000000ul) / m_u32TimerFreq;
}

uint32_t Timer6_Timebase_DeltaToMs(uint32_t u32DeltaCounter) {
    if (m_u32TimerFreq == 0) return 0;
    return (u32DeltaCounter * 1000ul) / m_u32TimerFreq;
}

uint32_t Timer6_Timebase_GetPulseInterval(void) {
    uint32_t u32Delta = Timer6_Timebase_GetDelta();
    return Timer6_Timebase_DeltaToUs(u32Delta);
}

uint32_t Timer6_Timebase_GetPulseTime(uint8_t pulse_count) {
    if (pulse_count < 2) return 0;
    uint32_t delta = Timer6_Timebase_GetDelta();
    uint32_t time_us = Timer6_Timebase_DeltaToUs(delta);
    return time_us * (pulse_count - 1);
}

float Timer6_Timebase_CalculateRPM(uint32_t time_us, uint8_t pulses, uint8_t pulses_per_rev) {
    if (time_us == 0 || pulses == 0 || pulses_per_rev == 0) return 0.0f;
    float rpm = (float)pulses * 60000000.0f;
    rpm /= (float)pulses_per_rev * (float)time_us;
    return rpm;
}

void Timer6_Timebase_UpdateTimestamp(void) {
    uint32_t current_counter = Timer6_Timebase_GetCounter();
    uint32_t delta;
    
    if (!s_timestamp_initialized) {
        s_last_timer6_counter = current_counter;
        s_timestamp_initialized = 1;
        return;
    }
    
    if (current_counter >= s_last_timer6_counter) {
        delta = current_counter - s_last_timer6_counter;
    } else {
        delta = (0x10000u - s_last_timer6_counter) + current_counter;
    }
    
    uint32_t delta_us = Timer6_Timebase_DeltaToUs(delta);
    s_total_elapsed_us += delta_us;
    s_last_timer6_counter = current_counter;
}

uint64_t Timer6_Timebase_GetTimestamp(void) {
    return s_total_elapsed_us;
}
